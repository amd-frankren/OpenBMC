## meta-amd/meta-2x1poc/conf/layer.conf
```bitbake
# We have a conf and classes directory, add to BBPATH
BBPATH .= ":${LAYERDIR}"

# We have recipes-* directories, add to BBFILES
BBFILES += "${LAYERDIR}/recipes-*/*/*.bb \
	${LAYERDIR}/recipes-*/*/*.bbappend"

BBFILE_COLLECTIONS += "2x1poc-layer"
BBFILE_PATTERN_2x1poc-layer = "^${LAYERDIR}/"
BBFILE_PRIORITY_2x1poc-layer = "6"

LAYERSERIES_COMPAT_2x1poc-layer = "langdale mickledore"
```

## meta-amd/meta-2x1poc/conf/machine/2x1poc.conf
```bitbake
KMACHINE = "aspeed"
KERNEL_DEVICETREE = "${KMACHINE}-bmc-amd-${MACHINE}.dtb"

UBOOT_MACHINE = "ast2600_openbmc_defconfig"
UBOOT_DEVICETREE = "ast2600-jamaica"

require conf/machine/include/ast2600.inc
require conf/machine/include/obmc-bsp-common.inc
require conf/machine/include/amd.inc

SERIAL_CONSOLES = "115200;ttyS4"

FLASH_SIZE = "131072"
```

## meta-amd/meta-sp7/conf/layer.conf
```bitbake
# We have a conf and classes directory, add to BBPATH
BBPATH .= ":${LAYERDIR}"

# We have recipes-* directories, add to BBFILES
BBFILES += "${LAYERDIR}/recipes-*/*/*.bb \
            ${LAYERDIR}/recipes-*/*/*.bbappend"

BBFILE_COLLECTIONS += "sp7-layer"
BBFILE_PATTERN_sp7-layer := "^${LAYERDIR}/"
BBFILE_PRIORITY_sp7-layer = "6"

LAYERSERIES_COMPAT_sp7-layer = "nanbield scarthgap"
```

## meta-amd/meta-sp7/conf/machine/sp7.conf
```bitbake
# Overwrite flash layout
FLASH_SIZE = "44032"
FLASH_CALIPTRA_SIZE:flash-44032 = "128"
FLASH_BMCU_SIZE:flash-44032 = "896"
FLASH_UBOOT_OFFSET:flash-44032 = "0"
FLASH_UBOOT_ENV_OFFSET:flash-44032 = "4096"
FLASH_KERNEL_OFFSET:flash-44032 = "4224"
FLASH_ROFS_OFFSET:flash-44032 = "12416" 
FLASH_RWFS_OFFSET:flash-44032 = "41984"
RWFS_SIZE = "2097152"


###############################################################################
# PFR
# PFR settings
PFR_IMAGE_SIZE = "131072"
# 0x04000000
PFM_OFFSET_PAGE = "44032"
# 0x04220000
RC_IMAGE_PAGE = "46208"
PFR_MANIFEST = "pfr_manifest_ast2700_dcscm.json"
# 1 = SHA256
# 2 = SHA384
# 3 = LMS384
# 4 = LMS256
PFR_SHA = "2"
###############################################################################



# Kernel Build Settings
KMACHINE = "aspeed"
KERNEL_DEVICETREE = "aspeed/${KMACHINE}-bmc-amd-congo.dtb \
                     aspeed/${KMACHINE}-bmc-amd-ghana.dtb \
                     aspeed/${KMACHINE}-bmc-amd-kenya.dtb \
                     aspeed/${KMACHINE}-bmc-amd-marley.dtb \
                     aspeed/${KMACHINE}-bmc-amd-morocco.dtb \
                     aspeed/${KMACHINE}-bmc-amd-nigeria.dtb \
                    "

# U-Boot Build Settings
UBOOT_MACHINE = "ast2700_sp7_defconfig"
UBOOT_DEVICETREE = "ast2700-sp7"
UBOOT_SIGN_ENABLE = "0"
UBOOT_FITIMAGE_ENABLE = "1"

# CALIPTRA Settings
CALIPTRA_FW_BINARY = "ast2700-caliptra-fw.bin"

# BootMCU Build Settings
BOOTMCU_MACHINE = "ibex-ast2700_defconfig"
BOOTMCU_FW_BINARY = "ast2700-ibex-spl.bin"

require conf/machine/include/ast2700-sdk.inc
require conf/machine/include/ast-optee-os.inc
require conf/machine/include/ast-caliptra.inc
require conf/machine/include/obmc-bsp-common.inc
require conf/machine/include/amd-withhost.inc
require conf/machine/include/amd-config-mgr.inc
require conf/distro/include/pldm.inc

#TODO Enable once back-end support available
IMAGE_FEATURES:remove:sp7 = " \
        obmc-leds \
        obmc-fan-control \
        obmc-fan-mgmt \
"

# TODO: Enable these recipe's once the sp7 machine specific
#       support is available.
BMASK += "recipes-amd/amd-fpga/amd-fpga.bb"

SERIAL_CONSOLES = "115200;ttyS12"

OVERRIDES .= ":amd"

MACHINE_EXTRA_RRECOMMENDS += "kernel-module-mipi-i3c-hci"
```

## meta-aspeed-sdk/conf/machine/include/aspeed-sdk.inc
```bitbake
PREFERRED_PROVIDER_virtual/kernel ?= "linux-aspeed"
PREFERRED_PROVIDER_virtual/bootloader ?= "u-boot-aspeed-sdk"
PREFERRED_PROVIDER_u-boot ?= "u-boot-aspeed-sdk"
PREFERRED_PROVIDER_u-boot-fw-utils ?= "u-boot-fw-utils-aspeed-sdk"

# Build a FIT image and stuff core-image-minimal in it by default.
KERNEL_IMAGETYPE ?= "fitImage"
KERNEL_CLASSES ?= "kernel-fitimage"
INITRAMFS_FSTYPES ?= "cpio.xz"

WKS_FILE_DEPENDS ?= " \
    phosphor-hostfw-image \
    virtual/bootloader \
    virtual/kernel \
"
WKS_HOSTFW_SIZE ?= "5G"
IMAGE_BOOT_FILES ?= "fitImage-${INITRAMFS_IMAGE}-${MACHINE}-${MACHINE};fitImage"

MACHINE_EXTRA_RRECOMMENDS += "udev-aspeed-vuart udev-aspeed-mtd-partitions"
MACHINE_FEATURES += "hw-rng"

MACHINEOVERRIDES =. "aspeed:"

# Installs static development packages, which are static libraries (i.e. *.a files), for all packages installed in a given SDK
SDKIMAGE_FEATURES += "staticdev-pkgs"
```
